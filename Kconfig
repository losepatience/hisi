## Kconfig
```kconfig
mainmenu "IPNC Build Configuration"

choice
	prompt "MACH"
	default MACH_HI3518C
	---help---
	  Select the target soc.

config MACH_HI3518A
	bool "hi3518a"

config MACH_HI3518C
	bool "hi3518c"

endchoice


config CROSS_COMPILER_PREFIX
	string "Cross Compiler Prefix"
	default "arm-hisiv100nptl-linux-"
	---help---
	  Select the cross-compiler prefix to compile u-boot and kernel.

source kernel/driver/Kconfig
source rootfs/Kconfig
```

## kernel/driver/Kconfig
```kconfig
menuconfig HANBANG_DEVICES
	bool "Build IPNC Device Drivers"
	default y

if HANBANG_DEVICES

config RTC_DRV_HISI3518
	bool "Hisi3518 RTC Driver"
	default y
	---help---
	  If you say yes here you get support for RTC function in
	  Hisi3518 chips.

	  This driver can also be built as a module. If so, the module
	  will be called rtc-hisi3518.

config GPIO_HISI
	bool "Hisi3518 series General-purpose I/O Uint support"
	default y
	---help---
	  Say yes here to support the General-purpose I/O Uint

config W1_DS28E10
	bool "DS28E10 1-Wire® SHA-1 Authenticator"
	depends on GPIO_HISI
	default y
	---help---
	  Support for 1-wire SHA-1 authenticator DS28E10.

	  This driver can also be built as a module. If so, the module
	  will be called ds28e10.

	  If not sure, select "y"

config I2C_HISI3518
	bool "Hisi3518 I2C driver"
	default y
	---help---
	  Support for Hisi3518 I2C controller driver.

	  This driver can also be built as a module.  If so, the module
	  will be called i2c-hi3518.

config EEPROM_24LCX
	bool "24lc16 & 24lc32 EEPROM Driver"
	depends on I2C_HISI3518
	default y
	---help---
	  Enable this driver to get read/write support to 24cl16/32 EEPROMs.

	  If you use this with an SMBus adapter instead of an I2C adapter,
	  full functionality is not available.  Only smaller devices are
	  supported (24c16 and below, max 4 kByte).

	  This driver can also be built as a module.  If so, the module
	  will be called 24lcx.

endif	# HANBANG_DEVICES
```

## pub/update_firmware.its
```
/*
 * Automatic software update for Firmware
 * Make sure the flashing addresses ('load' prop) is correct for your board!
 */

/dts-v1/;

/ {
	description = "IPNC auto-tftp firmware";
	#address-cells = <1>;

	images {
		update@1 {
			description = "u-boot";
			data = /incbin/("./images/uboot.bin");
			type = "standalone";
			compression = "none";
			arch = "arm";
			load = <0x00000000>;
			entry = <0x00100000>;
			hash@1 {
				algo = "md5";
			};
		};
		update@2 {
			description = "kernel";
			data = /incbin/("./images/uImage");
			type = "kernel";
			compression = "none";
			arch = "arm";
			os = "linux";
			load = <0x00100000>;
			entry = <0x00200000>;
			hash@1 {
				algo = "md5";
			};
		};
		update@3 {
			description = "rootfs";
			data = /incbin/("./images/rootfs.bin");
			type = "standalone";
			compression = "none";
			arch = "arm";
			load = <0x00400000>;
			entry = <0x00400000>;
			hash@1 {
				algo = "md5";
			};
		};
		update@4 {
			description = "logfs";
			data = /incbin/("./images/logfs.jffs2");
			type = "standalone";
			compression = "none";
			arch = "arm";
			load = <0x00300000>;
			entry = <0x00100000>;
			hash@1 {
				algo = "md5";
			};
		};
		update@5 {
			description = "appfs";
			data = /incbin/("./images/appfs.cramfs");
			type = "standalone";
			compression = "none";
			arch = "arm";
			load = <0x00800000>;
			entry = <0x00800000>;
			hash@1 {
				algo = "md5";
			};
		};
	};
};
```

## rootfs/Kconfig
```kconfig
menuconfig IPNC_MKFS
	bool "Build IPNC File System"
	default y
	---help---
	  Build IPNC File System.

if IPNC_MKFS

choice
	prompt "Linux Root File System"
	default ROOTFS_CRAMFS
	---help---
	  Select rootfs.

config ROOTFS_CRAMFS
	bool "Cramfs"
config ROOTFS_JFFS2
	bool "Jffs2"

endchoice

choice
	prompt "Select Erase Size of JFFS2"
        depends on ROOTFS_JFFS2
	default JFFS2_64K
	---help---
	  Select erase block size. If you use a erase block size different
	  than the erase block size of the target MTD device, JFFS2 may not
	  perform optimally.

config JFFS2_64KiB
	bool "64KiB"
config JFFS2_128KiB
	bool "128KiB"
config JFFS2_256KiB
	bool "256KiB"

endchoice

endif	# HANBANG_DEVICES
```
